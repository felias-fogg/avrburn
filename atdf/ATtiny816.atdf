# ATtiny816 device description
Architecture: AVR8X; Family: AVR TINY
Registers are 8-bit, read-write, no defined reset value unless marked. A register's access mark holds for its fields unless they carry their own. Offsets are from the block's base; [hi:lo] are bit positions; {n}, {i} and the like mark numbered series; 'fields as' and 'values as' point back to an identical list.

## EVSYS — Event System
Instances: EVSYS 0x0180
0x00 ASYNCSTROBE — Asynchronous Strobe
0x01 SYNCSTROBE — Synchronous Strobe
0x02 ASYNCCH0 — Asynchronous Multiplexer Channel 0
  [7:0] ASYNCCH0
    0=OFF; 1=CCL_LUT0 (Configurable Custom Logic LUT0); 2=CCL_LUT1 (Configurable Custom Logic LUT1); 3=AC0_OUT (Analog Comparator 0 out); 4=TCD0_CMPBCLR (Timer/Counter D0 compare B clear); 5=TCD0_CMPASET (Timer/Counter D0 compare A set); 6=TCD0_CMPBSET (Timer/Counter D0 compare B set); 7=TCD0_PROGEV (Timer/Counter D0 program event); 8=RTC_OVF (Real Time Counter overflow); 9=RTC_CMP (Real Time Counter compare); {v}=PORTA_PIN{v-10} (Asynchronous Event from Pin PA{v-10}) (v=10..17); 18=UPDI (Unified Program and debug interface)
0x03 ASYNCCH1 — Asynchronous Multiplexer Channel 1
  [7:0] ASYNCCH1
    0=OFF; 1=CCL_LUT0 (Configurable custom logic LUT0); 2=CCL_LUT1 (Configurable custom logic LUT1); 3=AC0_OUT (Analog Comparator 0 out); 4=TCD0_CMPBCLR (Timer/Counter D0 compare B clear); 5=TCD0_CMPASET (Timer/Counter D0 compare A set); 6=TCD0_CMPBSET (Timer/Counter D0 compare B set); 7=TCD0_PROGEV (Timer/Counter D0 program event); 8=RTC_OVF (Real Time Counter overflow); 9=RTC_CMP (Real Time Counter compare); {v}=PORTB_PIN{v-10} (Asynchronous Event from Pin PB{v-10}) (v=10..17)
0x04 ASYNCCH2 — Asynchronous Multiplexer Channel 2
  [7:0] ASYNCCH2
    0=OFF; 1=CCL_LUT0 (Configurable Custom Logic LUT0); 2=CCL_LUT1 (Configurable Custom Logic LUT1); 3=AC0_OUT (Analog Comparator 0 out); 4=TCD0_CMPBCLR (Timer/Counter D0 compare B clear); 5=TCD0_CMPASET (Timer/Counter D0 compare A set); 6=TCD0_CMPBSET (Timer/Counter D0 compare B set); 7=TCD0_PROGEV (Timer/Counter D0 program event); 8=RTC_OVF (Real Time Counter overflow); 9=RTC_CMP (Real Time Counter compare); {v}=PORTC_PIN{v-10} (Asynchronous Event from Pin PC{v-10}) (v=10..15)
0x05 ASYNCCH3 — Asynchronous Multiplexer Channel 3
  [7:0] ASYNCCH3
    0=OFF; 1=CCL_LUT0 (Configurable custom logic LUT0); 2=CCL_LUT1 (Configurable custom logic LUT1); 3=AC0_OUT (Analog Comparator 0 out); 4=TCD0_CMPBCLR (Timer/Counter type D compare B clear); 5=TCD0_CMPASET (Timer/Counter type D compare A set); 6=TCD0_CMPBSET (Timer/Counter type D compare B set); 7=TCD0_PROGEV (Timer/Counter type D program event); 8=RTC_OVF (Real Time Counter overflow); 9=RTC_CMP (Real Time Counter compare); 10=PIT_DIV8192 (Periodic Interrupt CLK_RTC div 8192); 11=PIT_DIV4096 (Periodic Interrupt CLK_RTC div 4096); 12=PIT_DIV2048 (Periodic Interrupt CLK_RTC div 2048); 13=PIT_DIV1024 (Periodic Interrupt CLK_RTC div 1024); 14=PIT_DIV512 (Periodic Interrupt CLK_RTC div 512); 15=PIT_DIV256 (Periodic Interrupt CLK_RTC div 256); 16=PIT_DIV128 (Periodic Interrupt CLK_RTC div 128); 17=PIT_DIV64 (Periodic Interrupt CLK_RTC div 64)
0x0A SYNCCH0 — Synchronous User Selection Ch 0
  [7:0] SYNCCH0 — Asynchronous User Selection Ch 0
    0=OFF; 1=TCB0 (Timer/Counter B0); 2=TCA0_OVF_LUNF (Timer/Counter A0 overflow); 3=TCA0_HUNF (Timer/Counter A0 underflow high byte (split mode)); 4=TCA0_CMP0 (Timer/Counter A0 compare 0); 5=TCA0_CMP1 (Timer/Counter A0 compare 1); 6=TCA0_CMP2 (Timer/Counter A0 compare 2); {v}=PORTC_PIN{v-7} (Synchronous Event from Pin PC{v-7}) (v=7..12); {v}=PORTA_PIN{v-13} (Synchronous Event from Pin PA{v-13}) (v=13..20)
0x0B SYNCCH1 — Synchronous Multiplexer Channel 1
  [7:0] SYNCCH1
    0=OFF; 1=TCB0 (Timer/Counter B0); 2=TCA0_OVF_LUNF (Timer/Counter A0 overflow); 3=TCA0_HUNF (Timer/Counter A0 underflow high byte (split mode)); 4=TCA0_CMP0 (Timer/Counter A0 compare 0); 5=TCA0_CMP1 (Timer/Counter A0 compare 1); 6=TCA0_CMP2 (Timer/Counter A0 compare 2); {v}=PORTB_PIN{v-8} (Synchronous Event from Pin PB{v-8}) (v=8..15)
0x12 ASYNCUSER0 — Asynchronous User Selection Ch 0 - TCB0
  [7:0] ASYNCUSER0
    0=OFF; 1=SYNCCH0 (Synchronous Event Channel 0); 2=SYNCCH1 (Synchronous Event Channel 1); {v}=ASYNCCH{v-3} (Asynchronous Event Channel {v-3}) (v=3..6)
0x13 ASYNCUSER1 — Asynchronous User Selection Ch 1 - ADC0
  [7:0] ASYNCUSER1
    values as ASYNCUSER0.ASYNCUSER0
0x14 ASYNCUSER2 — Asynchronous User Selection Ch 2 - CCL LUT0 Event 0
  [7:0] ASYNCUSER2
    values as ASYNCUSER0.ASYNCUSER0
0x15 ASYNCUSER3 — Asynchronous User Selection Ch 3 - CCL LUT1 Event 0
  [7:0] ASYNCUSER3
    values as ASYNCUSER0.ASYNCUSER0
0x16 ASYNCUSER4 — Asynchronous User Selection Ch 4 - CCL LUT0 Event 1
  [7:0] ASYNCUSER4
    values as ASYNCUSER0.ASYNCUSER0
0x17 ASYNCUSER5 — Asynchronous User Selection Ch 5 - CCL LUT1 Event 1
  [7:0] ASYNCUSER5
    values as ASYNCUSER0.ASYNCUSER0
0x18 ASYNCUSER6 — Asynchronous User Selection Ch 6 - TCD0 Event 0
  [7:0] ASYNCUSER6
    values as ASYNCUSER0.ASYNCUSER0
0x19 ASYNCUSER7 — Asynchronous User Selection Ch 7 - TCD0 Event 1
  [7:0] ASYNCUSER7
    values as ASYNCUSER0.ASYNCUSER0
0x1A ASYNCUSER8 — Asynchronous Multiplexer User 8 - Event Out 0
  [7:0] ASYNCUSER8 — Asynchronous User Selection Ch 8 - Event Out 0
    values as ASYNCUSER0.ASYNCUSER0
0x1B ASYNCUSER9 — Asynchronous User Selection Ch 9 - Event Out 1
  [7:0] ASYNCUSER9
    values as ASYNCUSER0.ASYNCUSER0
0x1C ASYNCUSER10 — Asynchronous User Selection Ch 0 - Event Out 2
  [7:0] ASYNCUSER10 — Asynchronous User Selection Ch 10 - Event Out 2
    values as ASYNCUSER0.ASYNCUSER0
0x22 SYNCUSER0 — Synchronous User Ch 0 - TCA0
  [7:0] SYNCUSER0
    0=OFF; 1=SYNCCH1 (Synchronous Event Channel 0); 2=SYNCCH2 (Synchronous Event Channel 1)
0x23 SYNCUSER1 — Synchronous User Ch 1 - USART0
  [7:0] SYNCUSER1
    values as SYNCUSER0.SYNCUSER0
